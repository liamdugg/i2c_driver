/dts-v1/;
/plugin/;

&{/chosen/overlays} {
	i2c_overlay_dtb = "i2c_overlay.dts";
	i2c_overlay_timestamp = "Thu Dec  15 16:33:09 2023";
};

&{/ocp/} {

	#address-cells = <0x01>;
	#size-cells = <0x01>;

	i2c@4819c000{
		status = "disabled";
	};

	i2c-liam@4819c000{

		#address-cells = <0x01>;
		#size-cells = <0x00>;
		compatible = "liam,i2c";
		ti,hwmods = "i2c3";
		status = "okay";
		
		reg = < 0x4819c000 0x1000 >;
		interrupts = < 0x1e >;
		pinctrl-names = "default";
		pinctrl-0;
		clock-frequency = < 0x186a0 >;
		symlink = "bone/i2c/2";
				
	};
};
